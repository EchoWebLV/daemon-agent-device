// ---------------------------------------------------------------------------
//  HTTP server. See server.h.
//
//  The page itself is shipped as an embedded asset (html/index.html). A
//  pre-build script (scripts/embed_assets.py, wired via platformio.ini)
//  turns it into a generated C file that exports a raw byte array plus its
//  length, which we feed straight to httpd_resp_send.
// ---------------------------------------------------------------------------
#include "server.h"

#include <stdio.h>
#include <stdlib.h>
#include <string.h>

#include "cJSON.h"
#include "devcfg.h"
#include "skill_store.h"
#include "social_x.h"
#include "ui.h"
#include "esp_check.h"
#include "esp_http_server.h"
#include "esp_log.h"

static const char *TAG = "http";

// --- Embedded assets (generated by scripts/embed_assets.py) -----------------
extern const char   index_html_start[];
extern const size_t index_html_len;
extern const char   mcp_mjs_start[];
extern const size_t mcp_mjs_len;

// --- Module state ------------------------------------------------------------
#define STATUS_MAX 64
#define REPLY_MAX  1024
// Bumped past devcfg's SVC_CUSTOM_MAX (4096) so a worst-case saveSettings
// POST — full custom-services JSON plus a few small fields — fits with
// room to spare for the surrounding JSON envelope.
#define BODY_MAX   8192
// /config GET serializes model + escaped persona (worst case 1024*6 = 6144)
// + servicesEnabled (512) + customServices (4096) into one envelope. That
// can blow past BODY_MAX, which would 500 the request and the web UI would
// silently render an empty form. Size the response buffer for that worst
// case so save → refresh round-trips reliably.
#define CONFIG_GET_MAX 16384

static httpd_handle_t         s_httpd   = NULL;
static server_say_handler_t   s_on_say  = NULL;
static char                   s_status[STATUS_MAX] = "booting";

// --- Helpers -----------------------------------------------------------------
static esp_err_t send_json(httpd_req_t *req, int code, const char *body) {
    httpd_resp_set_type(req, "application/json");
    httpd_resp_set_status(req, code == 200 ? "200 OK"
                             : code == 400 ? "400 Bad Request"
                                           : "500 Internal Server Error");
    return httpd_resp_sendstr(req, body);
}

// Escape a UTF-8 string into a JSON-string literal (without the surrounding
// quotes). Writes up to `cap-1` bytes + NUL. Truncates gracefully. Only
// handles the minimum set the phone UI cares about; adequate for chat text.
static void json_escape(const char *in, char *out, size_t cap) {
    size_t o = 0;
    for (const char *p = in; *p && o + 2 < cap; ++p) {
        unsigned char c = (unsigned char)*p;
        if      (c == '"' ) { if (o + 2 >= cap) break; out[o++] = '\\'; out[o++] = '"';  }
        else if (c == '\\') { if (o + 2 >= cap) break; out[o++] = '\\'; out[o++] = '\\'; }
        else if (c == '\n') { if (o + 2 >= cap) break; out[o++] = '\\'; out[o++] = 'n';  }
        else if (c == '\r') { if (o + 2 >= cap) break; out[o++] = '\\'; out[o++] = 'r';  }
        else if (c == '\t') { if (o + 2 >= cap) break; out[o++] = '\\'; out[o++] = 't';  }
        else if (c < 0x20)  { if (o + 6 >= cap) break;
                              o += (size_t)snprintf(out + o, cap - o,
                                                    "\\u%04x", c); }
        else                { out[o++] = (char)c; }
    }
    out[o] = '\0';
}

// Read the entire POST body into `buf` (capped at cap-1). Returns bytes
// read, or -1 on error.
static int read_body(httpd_req_t *req, char *buf, size_t cap) {
    size_t total = req->content_len;
    if (total >= cap) total = cap - 1;
    size_t read = 0;
    while (read < total) {
        int r = httpd_req_recv(req, buf + read, total - read);
        if (r <= 0) {
            if (r == HTTPD_SOCK_ERR_TIMEOUT) continue;
            return -1;
        }
        read += (size_t)r;
    }
    buf[read] = '\0';
    return (int)read;
}

// --- Handlers ----------------------------------------------------------------
static esp_err_t handle_root(httpd_req_t *req) {
    httpd_resp_set_type(req, "text/html; charset=utf-8");
    return httpd_resp_send(req, index_html_start, index_html_len);
}

// GET /mcp.mjs — serves the embedded daemon-mcp.mjs source so any device
// owner can curl it down and configure Claude Code without needing the
// repo. Self-hosting: the device IS the source of truth.
static esp_err_t handle_mcp_mjs(httpd_req_t *req) {
    httpd_resp_set_type(req, "text/javascript; charset=utf-8");
    // Cache for an hour — script only changes on firmware updates.
    httpd_resp_set_hdr(req, "Cache-Control", "public, max-age=3600");
    return httpd_resp_send(req, mcp_mjs_start, mcp_mjs_len);
}

static esp_err_t handle_state(httpd_req_t *req) {
    // Worst-case JSON escape of a control byte is \uXXXX (6x), so size the
    // escape buffer 6x the status capacity; the compiler uses the upper bound
    // when checking snprintf, not runtime content.
    char escaped[STATUS_MAX * 6 + 1];
    json_escape(s_status, escaped, sizeof(escaped));
    char body[sizeof(escaped) + 32];
    snprintf(body, sizeof(body), "{\"status\":\"%s\"}", escaped);
    return send_json(req, 200, body);
}

// POST /notify  body: { "text": "..." } -> { "ok": true }
// Speaks `text` directly without going through the LLM. Use case: external
// systems (Claude Code stop hooks, CI pipelines, doorbell, …) that just
// want to push a string at the device. Bypasses chat history + x402 cost
// since there's no model call.
static esp_err_t handle_notify(httpd_req_t *req) {
    if (req->content_len == 0 || req->content_len > BODY_MAX) {
        return send_json(req, 400, "{\"error\":\"bad body\"}");
    }
    char *body = malloc(req->content_len + 1);
    if (!body) return send_json(req, 500, "{\"error\":\"oom\"}");
    int got = httpd_req_recv(req, body, req->content_len);
    if (got <= 0) { free(body); return send_json(req, 400, "{\"error\":\"empty\"}"); }
    body[got] = 0;

    cJSON *root = cJSON_Parse(body);
    free(body);
    if (!root) return send_json(req, 400, "{\"error\":\"bad_json\"}");
    cJSON *txt = cJSON_GetObjectItem(root, "text");
    if (!cJSON_IsString(txt) || !txt->valuestring || !txt->valuestring[0]) {
        cJSON_Delete(root);
        return send_json(req, 400, "{\"error\":\"missing_text\"}");
    }

    // Updates subtitle, sets mood TALK, kicks voice_speak() async.
    ui_deliver_reply(txt->valuestring);
    cJSON_Delete(root);
    return send_json(req, 200, "{\"ok\":true}");
}

static esp_err_t handle_say(httpd_req_t *req) {
    if (req->content_len == 0 || req->content_len > BODY_MAX) {
        return send_json(req, 400, "{\"error\":\"bad body\"}");
    }
    char *user = malloc(req->content_len + 1);
    if (!user) return send_json(req, 500, "{\"error\":\"oom\"}");

    int n = read_body(req, user, req->content_len + 1);
    if (n < 0) { free(user); return send_json(req, 400, "{\"error\":\"recv\"}"); }

    // Trim trailing whitespace; the phone occasionally sends "\n" after text.
    while (n > 0 && (user[n-1] == ' ' || user[n-1] == '\n' ||
                     user[n-1] == '\r' || user[n-1] == '\t')) {
        user[--n] = '\0';
    }
    if (n == 0) { free(user); return send_json(req, 400, "{\"error\":\"empty\"}"); }

    // Dispatch to the registered AI handler. Synchronous — the phone waits
    // until we have a reply string. If no handler is wired up (phase 2 runs
    // before AI lands) we just return an empty reply so the UI stays sane.
    char reply[REPLY_MAX] = { 0 };
    server_say_handler_t cb = s_on_say;
    if (cb) cb(user, reply, sizeof(reply));
    free(user);

    char esc[REPLY_MAX * 2 + 16];
    json_escape(reply, esc, sizeof(esc));
    char body[sizeof(esc) + 32];
    snprintf(body, sizeof(body), "{\"reply\":\"%s\"}", esc);
    return send_json(req, 200, body);
}

// /config exposes the persisted settings the phone UI needs: LLM model,
// personality, custom x402 services library and the subset enabled. The
// two service fields are stored as raw JSON strings in NVS so we embed
// them directly in the response envelope rather than re-parsing just to
// serialise again — devcfg guarantees "[]" when nothing has been saved.
static esp_err_t handle_config_get(httpd_req_t *req) {
    const char *model    = devcfg_llm_model();
    const char *persona  = devcfg_personality();
    const char *svc_all  = devcfg_custom_services();
    const char *svc_on   = devcfg_services_enabled();

    // Worst-case JSON escape is 6x (a run of control bytes encoded as
    // \uXXXX). Personality is up to 1024 chars so a stack buffer would
    // be ~6 KB — the httpd task has 16 KB of stack but /say uses most
    // of it for TLS, so keep this off the stack.
    char *model_esc   = malloc(96 * 6 + 1);
    char *persona_esc = malloc(1024 * 6 + 1);
    char *body        = malloc(CONFIG_GET_MAX);
    if (!model_esc || !persona_esc || !body) {
        free(model_esc); free(persona_esc); free(body);
        return send_json(req, 500, "{\"error\":\"oom\"}");
    }
    json_escape(model,   model_esc,   96 * 6 + 1);
    json_escape(persona, persona_esc, 1024 * 6 + 1);

    int n = snprintf(body, CONFIG_GET_MAX,
                     "{\"model\":\"%s\",\"personality\":\"%s\","
                     "\"servicesEnabled\":%s,\"customServices\":%s}",
                     model_esc, persona_esc, svc_on, svc_all);
    esp_err_t err = (n > 0 && n < CONFIG_GET_MAX)
        ? send_json(req, 200, body)
        : send_json(req, 500, "{\"error\":\"body too large\"}");
    free(model_esc);
    free(persona_esc);
    free(body);
    return err;
}

// Phone UI POSTs a partial-update JSON object — any combination of
// model, personality, customServices (array), servicesEnabled (array).
// Arrays are re-serialised back to a string before hitting NVS so the
// storage layer stays opaque to cJSON.
static esp_err_t handle_config_post(httpd_req_t *req) {
    if (req->content_len == 0 || req->content_len > BODY_MAX) {
        // Drain partial body so the client gets a clean 400 instead of a
        // stalled connection reset.
        char scratch[256];
        int remaining = req->content_len;
        while (remaining > 0) {
            int r = httpd_req_recv(req, scratch,
                                   remaining < (int)sizeof(scratch)
                                       ? remaining : (int)sizeof(scratch));
            if (r <= 0) break;
            remaining -= r;
        }
        return send_json(req, 400, "{\"error\":\"bad body\"}");
    }

    char *buf = malloc(req->content_len + 1);
    if (!buf) return send_json(req, 500, "{\"error\":\"oom\"}");
    int n = read_body(req, buf, req->content_len + 1);
    if (n < 0) { free(buf); return send_json(req, 400, "{\"error\":\"recv\"}"); }

    cJSON *root = cJSON_Parse(buf);
    free(buf);
    if (!root) return send_json(req, 400, "{\"error\":\"json\"}");

    const cJSON *j_model   = cJSON_GetObjectItemCaseSensitive(root, "model");
    const cJSON *j_persona = cJSON_GetObjectItemCaseSensitive(root, "personality");
    const cJSON *j_svc_all = cJSON_GetObjectItemCaseSensitive(root, "customServices");
    const cJSON *j_svc_on  = cJSON_GetObjectItemCaseSensitive(root, "servicesEnabled");

    if (cJSON_IsString(j_model))   devcfg_set_llm_model(j_model->valuestring);
    if (cJSON_IsString(j_persona)) devcfg_set_personality(j_persona->valuestring);

    // cJSON_PrintUnformatted allocates — free before falling through.
    if (cJSON_IsArray(j_svc_all)) {
        char *s = cJSON_PrintUnformatted(j_svc_all);
        if (s) { devcfg_set_custom_services(s); cJSON_free(s); }
    }
    if (cJSON_IsArray(j_svc_on)) {
        char *s = cJSON_PrintUnformatted(j_svc_on);
        if (s) { devcfg_set_services_enabled(s); cJSON_free(s); }
    }

    cJSON_Delete(root);
    return send_json(req, 200, "{\"ok\":true}");
}

// --- Social / X handlers -----------------------------------------------------

// GET /social/x/state -> { connected, configured, handle?, client_id, redirect_uri, style }
static esp_err_t handle_x_state(httpd_req_t *req) {
    // Style can be up to 512 chars; size the response buffer to absorb it
    // plus the other fields without truncation.
    char *body = malloc(1536);
    if (!body) return send_json(req, 500, "{\"error\":\"oom\"}");

    // We need to JSON-escape the style string in case it has quotes / backslashes
    // / newlines. cJSON.h is already available in this file; build via cJSON
    // for safety rather than hand-escaping.
    cJSON *root = cJSON_CreateObject();
    cJSON_AddBoolToObject(root,   "connected",    devcfg_x_connected());
    cJSON_AddBoolToObject(root,   "configured",   devcfg_x_configured());
    cJSON_AddStringToObject(root, "handle",       devcfg_x_handle()       ?: "");
    cJSON_AddStringToObject(root, "client_id",    devcfg_x_client_id()    ?: "");
    cJSON_AddStringToObject(root, "redirect_uri", devcfg_x_redirect_uri() ?: "");
    cJSON_AddStringToObject(root, "style",        devcfg_x_style()        ?: "");
    char *out = cJSON_PrintUnformatted(root);
    cJSON_Delete(root);
    if (!out) { free(body); return send_json(req, 500, "{\"error\":\"oom\"}"); }
    esp_err_t rc = send_json(req, 200, out);
    free(out);
    free(body);
    return rc;
}

// POST /social/x/config  body: { client_id?, redirect_uri?, style? } -> { ok: true }
// Persists the dev-app credentials AND/OR the writing style. Each field is
// optional; only fields present in the body are updated. style accepts an
// empty string to clear it.
static esp_err_t handle_x_config(httpd_req_t *req) {
    char *buf = malloc(2048);
    if (!buf) return send_json(req, 500, "{\"error\":\"oom\"}");
    int len = httpd_req_recv(req, buf, 2048 - 1);
    if (len <= 0) { free(buf); return send_json(req, 400, "{\"error\":\"no_body\"}"); }
    buf[len] = 0;
    cJSON *root = cJSON_Parse(buf);
    free(buf);
    if (!root) return send_json(req, 400, "{\"error\":\"bad_json\"}");

    cJSON *cid   = cJSON_GetObjectItem(root, "client_id");
    cJSON *uri   = cJSON_GetObjectItem(root, "redirect_uri");
    cJSON *style = cJSON_GetObjectItem(root, "style");

    if (cJSON_IsString(cid) && cid->valuestring) {
        devcfg_set_x_client_id(cid->valuestring);
    }
    if (cJSON_IsString(uri) && uri->valuestring && uri->valuestring[0]) {
        devcfg_set_x_redirect_uri(uri->valuestring);
    }
    if (cJSON_IsString(style)) {
        // Allow empty string to clear the style.
        devcfg_set_x_style(style->valuestring ? style->valuestring : "");
    }
    cJSON_Delete(root);
    return send_json(req, 200, "{\"ok\":true}");
}

// POST /social/x/begin -> { "auth_url": "..." }
static esp_err_t handle_x_begin(httpd_req_t *req) {
    char url[512];
    if (!social_x_begin(url, sizeof(url))) {
        return send_json(req, 500, "{\"error\":\"begin_failed\"}");
    }
    char body[600];
    snprintf(body, sizeof(body), "{\"auth_url\":\"%s\"}", url);
    return send_json(req, 200, body);
}

// POST /social/x/finish  body: { "code": "..." } -> { "ok": bool, ... }
static esp_err_t handle_x_finish(httpd_req_t *req) {
    char buf[2048];
    int len = httpd_req_recv(req, buf, sizeof(buf) - 1);
    if (len <= 0) return send_json(req, 400, "{\"error\":\"no_body\"}");
    buf[len] = 0;
    cJSON *root = cJSON_Parse(buf);
    if (!root) return send_json(req, 400, "{\"error\":\"bad_json\"}");
    cJSON *code = cJSON_GetObjectItem(root, "code");
    if (!cJSON_IsString(code) || !code->valuestring) {
        cJSON_Delete(root);
        return send_json(req, 400, "{\"error\":\"missing_code\"}");
    }
    char err[64] = {0};
    bool ok = social_x_finish(code->valuestring, err, sizeof(err));
    cJSON_Delete(root);
    if (!ok) {
        char body[160];
        snprintf(body, sizeof(body), "{\"ok\":false,\"error\":\"%s\"}", err);
        return send_json(req, 400, body);
    }
    char body[160];
    snprintf(body, sizeof(body),
             "{\"ok\":true,\"handle\":\"%s\"}",
             devcfg_x_handle()[0] ? devcfg_x_handle() : "");
    return send_json(req, 200, body);
}

// POST /social/x/disconnect -> { "ok": true }
static esp_err_t handle_x_disconnect(httpd_req_t *req) {
    social_x_disconnect();
    return send_json(req, 200, "{\"ok\":true}");
}

// --- Skills handlers ---------------------------------------------------------
//
// A skill is a markdown document with YAML-lite frontmatter that the AI
// reads from the system prompt. Bodies are persisted to LittleFS at
// /storage/skills/<id>.md and surfaced as markdown-kind entries in the
// existing custom-services list. See skill_store.h for the storage API.

#define SKILL_UPLOAD_MAX (64 * 1024)

// Drain remaining body bytes when we've decided to fail early so the client
// gets a clean response instead of a stalled connection.
static void drain_body(httpd_req_t *req) {
    char scratch[256];
    int remaining = (int)req->content_len;
    while (remaining > 0) {
        int r = httpd_req_recv(req, scratch,
                               remaining < (int)sizeof(scratch)
                                   ? remaining : (int)sizeof(scratch));
        if (r <= 0) break;
        remaining -= r;
    }
}

// POST /skills — raw markdown body. Parses frontmatter, validates, writes
// body to LittleFS, upserts a markdown-kind entry into svc_custom.
//
// Returns 200 + JSON metadata on success.
// 400 on missing fields / bad name; 413 on oversize; 507 on storage full.
static esp_err_t handle_skill_upload(httpd_req_t *req) {
    if (req->content_len == 0) {
        return send_json(req, 400, "{\"error\":\"empty_body\"}");
    }
    if (req->content_len > SKILL_UPLOAD_MAX) {
        drain_body(req);
        return send_json(req, 413,
            "{\"error\":\"too_large\",\"max_bytes\":65536}");
    }

    char *body = malloc(req->content_len + 1);
    if (!body) return send_json(req, 500, "{\"error\":\"oom\"}");
    int n = read_body(req, body, req->content_len + 1);
    if (n <= 0) { free(body); return send_json(req, 400, "{\"error\":\"recv\"}"); }

    skill_meta_t meta;
    size_t body_offset = 0;
    int rc = skill_store_parse_frontmatter(body, (size_t)n, &meta, &body_offset);
    if (rc != 0) {
        free(body);
        const char *err =
            rc == -1 ? "no_frontmatter" :
            rc == -2 ? "missing_required_field" :
            rc == -3 ? "field_too_long" :
                       "malformed_frontmatter";
        char msg[96];
        snprintf(msg, sizeof(msg), "{\"error\":\"%s\"}", err);
        return send_json(req, 400, msg);
    }

    // Validate id charset (parser is permissive; reject here for a clear error).
    bool id_ok = meta.id[0] != '\0';
    for (size_t i = 0; meta.id[i]; ++i) {
        char c = meta.id[i];
        if (!(c == '-' || c == '_' ||
              (c >= 'a' && c <= 'z') ||
              (c >= '0' && c <= '9'))) { id_ok = false; break; }
    }
    if (!id_ok) {
        free(body);
        return send_json(req, 400,
            "{\"error\":\"bad_name\",\"hint\":\"^[a-z0-9_-]+$\"}");
    }

    // Persist body (whole markdown, frontmatter included).
    esp_err_t we = skill_store_write_body(meta.id, body, (size_t)n);
    free(body);
    if (we == ESP_ERR_NO_MEM) {
        return send_json(req, 507, "{\"error\":\"storage_full\"}");
    } else if (we != ESP_OK) {
        return send_json(req, 500, "{\"error\":\"write_failed\"}");
    }

    // Upsert into svc_custom.
    if (skill_store_register(&meta) != ESP_OK) {
        // Roll back the body write so we don't leak orphans.
        skill_store_delete(meta.id);
        return send_json(req, 413, "{\"error\":\"registry_full\"}");
    }

    // Build response.
    cJSON *root = cJSON_CreateObject();
    cJSON_AddStringToObject(root, "id",          meta.id);
    cJSON_AddStringToObject(root, "name",        meta.name);
    cJSON_AddStringToObject(root, "description", meta.description);
    cJSON_AddStringToObject(root, "version",     meta.version);
    cJSON *creds = cJSON_AddArrayToObject(root, "credentials");
    for (int i = 0; i < meta.credentials_count; ++i) {
        cJSON_AddItemToArray(creds, cJSON_CreateString(meta.credentials[i]));
    }
    char *out = cJSON_PrintUnformatted(root);
    cJSON_Delete(root);
    if (!out) return send_json(req, 500, "{\"error\":\"oom\"}");
    esp_err_t rc2 = send_json(req, 200, out);
    cJSON_free(out);
    return rc2;
}

// Extract the skill id from a URI like "/skills/<id>" or
// "/skills/<id>/credentials". Returns true on success and writes the id
// (NUL-terminated) into `out`. Sets `*has_credentials` to true when the
// path's tail is "/credentials".
static bool parse_skills_uri(const char *uri, char *out, size_t cap,
                             bool *has_credentials) {
    *has_credentials = false;
    if (!uri || strncmp(uri, "/skills/", 8) != 0) return false;

    // Drop any query string.
    char path[128];
    strlcpy(path, uri, sizeof(path));
    char *q = strchr(path, '?');
    if (q) *q = '\0';

    const char *rest = path + 8;
    if (!*rest) return false;

    const char *slash = strchr(rest, '/');
    size_t id_len = slash ? (size_t)(slash - rest) : strlen(rest);
    if (id_len == 0 || id_len >= cap) return false;
    memcpy(out, rest, id_len);
    out[id_len] = '\0';

    if (slash) {
        if (strcmp(slash, "/credentials") != 0) return false;
        *has_credentials = true;
    }
    return true;
}

// DELETE /skills/<id>
static esp_err_t handle_skill_delete(httpd_req_t *req) {
    char id[SKILL_ID_MAX];
    bool has_creds = false;
    if (!parse_skills_uri(req->uri, id, sizeof(id), &has_creds) || has_creds) {
        return send_json(req, 404, "{\"error\":\"not_found\"}");
    }
    skill_store_delete(id);
    skill_store_unregister(id);
    return send_json(req, 200, "{\"ok\":true}");
}

// POST /skills/<id>/credentials  body: {"KEY":"value", ...}
static esp_err_t handle_skill_post_wildcard(httpd_req_t *req) {
    char id[SKILL_ID_MAX];
    bool has_creds = false;
    if (!parse_skills_uri(req->uri, id, sizeof(id), &has_creds) || !has_creds) {
        return send_json(req, 404, "{\"error\":\"not_found\"}");
    }
    if (req->content_len == 0 || req->content_len > 4096) {
        drain_body(req);
        return send_json(req, 400, "{\"error\":\"bad_body\"}");
    }
    char *buf = malloc(req->content_len + 1);
    if (!buf) return send_json(req, 500, "{\"error\":\"oom\"}");
    int n = read_body(req, buf, req->content_len + 1);
    if (n < 0) { free(buf); return send_json(req, 400, "{\"error\":\"recv\"}"); }

    esp_err_t rc = skill_store_set_creds_json(id, buf);
    free(buf);
    if (rc != ESP_OK) return send_json(req, 400, "{\"error\":\"bad_credentials\"}");

    char keys[256];
    skill_store_set_creds_keys(id, keys, sizeof(keys));
    char body[320];
    snprintf(body, sizeof(body), "{\"ok\":true,\"set\":%s}", keys);
    return send_json(req, 200, body);
}

// --- Public API --------------------------------------------------------------
esp_err_t server_start(void) {
    if (s_httpd) return ESP_OK;

    httpd_config_t cfg = HTTPD_DEFAULT_CONFIG();
    cfg.server_port     = 80;
    cfg.max_uri_handlers = 20;
    cfg.lru_purge_enable = true;
    // Wildcard URI matching for `/skills/*` (so DELETE /skills/<id> and
    // POST /skills/<id>/credentials route to a single handler each that
    // parses the rest). Existing exact-match URIs stay unaffected.
    cfg.uri_match_fn = httpd_uri_match_wildcard;
    // Cap httpd's slice of the LWIP socket pool. Default is
    // (CONFIG_LWIP_MAX_SOCKETS - 3), which on a 24-socket pool would let
    // httpd squat 21 — starving outbound HTTPS (AI / RPC / TTS) when the
    // web UI is polling fast and dead browser tabs leave sockets in
    // TIME_WAIT. 7 is plenty for a phone + laptop with 2-3 concurrent
    // polls each, and leaves the rest of the pool for outbound work.
    cfg.max_open_sockets = 7;
    // The /say path runs the full AI pipeline on the httpd task — that's
    // up to four TLS handshakes (LLM, two Solana RPC calls, LLM retry)
    // plus cJSON/mbedtls scratch. Default 4 KB blows the canary; 16 KB
    // leaves room for the stack growth inside mbedtls_ssl_handshake().
    cfg.stack_size       = 16384;
    cfg.recv_wait_timeout = 10;
    cfg.send_wait_timeout = 10;

    ESP_RETURN_ON_ERROR(httpd_start(&s_httpd, &cfg), TAG, "httpd_start");

    static const httpd_uri_t uris[] = {
        { .uri = "/",        .method = HTTP_GET,  .handler = handle_root        },
        { .uri = "/mcp.mjs", .method = HTTP_GET,  .handler = handle_mcp_mjs     },
        { .uri = "/state",   .method = HTTP_GET,  .handler = handle_state       },
        { .uri = "/say",    .method = HTTP_POST, .handler = handle_say         },
        { .uri = "/notify", .method = HTTP_POST, .handler = handle_notify      },
        { .uri = "/config", .method = HTTP_GET,  .handler = handle_config_get  },
        { .uri = "/config", .method = HTTP_POST, .handler = handle_config_post },
        { .uri = "/social/x/state",      .method = HTTP_GET,  .handler = handle_x_state      },
        { .uri = "/social/x/config",     .method = HTTP_POST, .handler = handle_x_config     },
        { .uri = "/social/x/begin",      .method = HTTP_POST, .handler = handle_x_begin      },
        { .uri = "/social/x/finish",     .method = HTTP_POST, .handler = handle_x_finish     },
        { .uri = "/social/x/disconnect", .method = HTTP_POST, .handler = handle_x_disconnect },
        { .uri = "/skills",          .method = HTTP_POST,   .handler = handle_skill_upload         },
        { .uri = "/skills/*",        .method = HTTP_POST,   .handler = handle_skill_post_wildcard  },
        { .uri = "/skills/*",        .method = HTTP_DELETE, .handler = handle_skill_delete         },
    };
    for (size_t i = 0; i < sizeof(uris) / sizeof(uris[0]); ++i) {
        ESP_RETURN_ON_ERROR(httpd_register_uri_handler(s_httpd, &uris[i]),
                            TAG, "register %s", uris[i].uri);
    }

    ESP_LOGI(TAG, "listening on :80 (%u bytes of HTML embedded)",
             (unsigned)index_html_len);
    return ESP_OK;
}

void server_stop(void) {
    if (!s_httpd) return;
    httpd_stop(s_httpd);
    s_httpd = NULL;
}

void server_set_say_handler(server_say_handler_t h) { s_on_say = h; }

void server_set_status(const char *status) {
    if (!status) status = "";
    strlcpy(s_status, status, sizeof(s_status));
}
